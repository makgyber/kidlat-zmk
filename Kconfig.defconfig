## Kconfig.defconfig
```kconfig
# Copyright (c) 2020 The ZMK Contributors
# SPDX-License-Identifier: MIT

if SHIELD_KIDLAT_RIGHT

config ZMK_KEYBOARD_NAME
	default "Kidlat"

config ZMK_SPLIT_BLE_ROLE_CENTRAL
	default y

endif

if SHIELD_KIDLAT_RIGHT || SHIELD_KIDLAT_LEFT 

config ZMK_SPLIT
	default y

endif
```

## Kconfig.shield
```kconfig
# Copyright (c) 2020 The ZMK Contributors
# SPDX-License-Identifier: MIT

config SHIELD_KIDLAT_LEFT
	def_bool $(shields_list_contains,kidlat_left)

config SHIELD_KIDLAT_RIGHT
	def_bool $(shields_list_contains,kidlat_right)
```
